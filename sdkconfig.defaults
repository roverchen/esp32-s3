## sdkconfig.defaults
```kconfig
CONFIG_SCCB_CLK_FREQ=100000
CONFIG_ESP32S3_ENABLE_USB_OTG=1       # 如果需要 USB
CONFIG_ESP32S3_ENABLE_OCM=1           # 如果需要 OCM
CONFIG_ESP32_WIFI_STATIC_RX_BUFFER_NUM=10  # 可依需求增加

CONFIG_SPIRAM_SUPPORT=y
CONFIG_ESP32S3_SPIRAM_SUPPORT=y
CONFIG_SPIRAM_MODE_QUAD=y
CONFIG_SPIRAM_TYPE_AUTO=y
CONFIG_ESP32S3_DEFAULT_PSRAM_CS_IO=26
CONFIG_ESP32S3_DATA_CACHE_64KB=y
CONFIG_ESP32S3_DATA_CACHE_LINE_64B=y
CONFIG_SPIRAM_CACHE_WORKAROUND=y
```
